/*
 * Copyright (c) 2020 The ZMK Contributors
 * Copyright (c) 2025 Innaworks Development Limited, trading as MoErgo
 *
 * SPDX-License-Identifier: MIT
 */


/* THIS FILE WAS GENERATED BY GLOVE80 LAYOUT EDITOR
 *
 * This file was generated automatically. You may or may not want to
 * edit it directly.
 */

#include <behaviors.dtsi>
/* Include all behavior includes needed */
#include <dt-bindings/zmk/outputs.h>
#include <dt-bindings/zmk/keys.h>
#include <dt-bindings/zmk/bt.h>
#include <dt-bindings/zmk/rgb.h>
// Already defined in the mouse section
/* #include <dt-bindings/zmk/rgb_colors.h> */

/* On demand includes */
/* #include <dt-bindings/zmk/pointing.h> */

/* Helper Macros, based on https://github.com/urob/zmk-helpers/ */

#pragma once

#define ZMK_HELPER_STRINGIFY(x) #x

// Preprocessor mechanism to overload macros, cf. https://stackoverflow.com/a/27051616/6114651
#define VARGS_(_10, _9, _8, _7, _6, _5, _4, _3, _2, _1, N, ...) N
#define VARGS(...) VARGS_(__VA_ARGS__, 10, 9, 8, 7, 6, 5, 4, 3, 2, 1, 0)
#define CONCAT_(a, b) a##b
#define CONCAT(a, b) CONCAT_(a, b)

#define ZMK_BEHAVIOR_CORE_tap_dance  \
    compatible = "zmk,behavior-tap-dance"; \
    #binding-cells = <0>

#define ZMK_BEHAVIOR(name, type, ...) \
    name: name { \
        ZMK_BEHAVIOR_CORE_ ## type; \
        __VA_ARGS__ \
    };

#define ZMK_TAP_DANCE(name, ...) \
    ZMK_BEHAVIOR(name, tap_dance, __VA_ARGS__)

#define ZMK_TD_LAYER(name, layer) \
    ZMK_TAP_DANCE(name, \
        tapping-term-ms = <200>; \
        bindings = <&mo layer>, <&to layer>; \
)

/* Automatically generated layer name #define */
#define LAYER_Base 0
#define LAYER_Navigation 1
#define LAYER_Symbols 2
#define LAYER_Numbers 3
#define LAYER_Function 4
#define LAYER_Magic 5
#define LAYER_Mouse 6
#define LAYER_MouseFine 7
#define LAYER_MouseSlow 8
#define LAYER_MouseFast 9
#define LAYER_MouseWarp 10

/* To deal with the situation where there is no Lower layer, to keep &lower happy */
#ifndef LAYER_Lower
#define LAYER_Lower 0
#endif


#define ENABLE_MOUSE_KEYS 1
/* Custom Device-tree */
//////////////////////////////////////////////////////////////////////////////
//
// Per-key RGB indicators for layers & mods -- requires PR36 beta firmware:
// override "EXPERIMENTAL_RGB_LAYER" to "y" in Advanced Configuration and
// select "community.pr36.per-key-rgb" from the drop-down menu located at
// Glove80 Layout Editor > Settings > Advanced Settings > Firmware Version
//
// - https://github.com/moergo-sc/zmk/pull/36
// - https://github.com/moergo-sc/zmk/pull/30
// - https://github.com/zmkfirmware/zmk/pull/2752
// - https://dev.glove80.com/#/layout/user/c42ac32d-dc0d-4160-9ee3-fd0fc15f1725
//
//////////////////////////////////////////////////////////////////////////////

#if __has_include(<dt-bindings/zmk/rgb_colors.h>)
  //
  // Color definitions with conflict guard to prevent
  // accidental redefinition of common abbreviations.
  //
  #if defined(RED) || defined(RED_RGB) || \
      defined(COR) || defined(COR_RGB) || \
      defined(ORN) || defined(ORN_RGB) || \
      defined(GDN) || defined(GDN_RGB) || \
      defined(GOL) || defined(GOL_RGB) || \
      defined(YLW) || defined(YLW_RGB) || \
      defined(CHU) || defined(CHU_RGB) || \
      defined(GRN) || defined(GRN_RGB) || \
      defined(SPG) || defined(SPG_RGB) || \
      defined(CYN) || defined(CYN_RGB) || \
      defined(AZU) || defined(AZU_RGB) || \
      defined(TEA) || defined(TEA_RGB) || \
      defined(TUR) || defined(TUR_RGB) || \
      defined(BLU) || defined(BLU_RGB) || \
      defined(PUR) || defined(PUR_RGB) || \
      defined(MAJ) || defined(MAJ_RGB) || \
      defined(PNK) || defined(PNK_RGB) || \
      defined(WHT) || defined(WHT_RGB) || \
      defined(BLK) || defined(BLK_RGB) || \
      defined(___) || \
      defined(DUG) || defined(DUG_RGB) || \
      defined(LAC) || defined(LAC_RGB) || \
      defined(BSL) || defined(BNL) || defined(BCL) || \
      defined(SSL) || defined(SNL) || defined(SCL) || \
      defined(FST) || defined(WRP) || defined(SLO) || defined(FIN)
  #error "Naming conflict: 3-letter color abbreviation already defined!"
  #endif

  //
  // color definitions from QMK
  // https://github.com/qmk/qmk_firmware/blob/master/quantum/color.h
  //
  #define RED_RGB 0xFF0000 // #FF0000 RED      => RED (red)
  #define COR_RGB 0xFF7C4D // #FF7C4D CORAL    => COR (coral)
  #define ORN_RGB 0xFF8000 // #FF8000 ORANGE   => ORN (ornj)
  #define GDN_RGB 0xD9A521 // #D9A521 GOLDNROD => GDN (gold'nrod)
  #define GOL_RGB 0xFFD900 // #FFD900 GOLD     => GOL (gold)
  #define YLW_RGB 0xFFFF00 // #FFFF00 YELLOW   => YLW (yellow)
  #define CHU_RGB 0x80FF00 // #80FF00 CHARTRSE => CHU (chartreuse)
  #define GRN_RGB 0x00FF00 // #00FF00 GREEN    => GRN (green)
  #define SPG_RGB 0x00FF80 // #00FF80 SPRINGRN => SPG (spring green)
  #define CYN_RGB 0x00FFFF // #00FFFF CYAN     => CYN (sigh-an)
  #define AZU_RGB 0x99F5FF // #99F5FF AZURE    => AZU (a-zur)
  #define TEA_RGB 0x008080 // #008080 TEAL     => TEA (teel)
  #define TUR_RGB 0x476E6A // #476E6A TURQUOIS => TUR (turquoise)
  #define BLU_RGB 0x0000FF // #0000FF BLUE     => BLU (bloo)
  #define PUR_RGB 0x7A00FF // #7A00FF PURPLE   => PUR (purp)
  #define MAJ_RGB 0xFF00FF // #FF00FF MAGENTA  => MAJ (mah-jenta)
  #define PNK_RGB 0xFF80BF // #FF80BF PINK     => PNK (pink)
  #define WHT_RGB 0xFFFFFF // #FFFFFF WHITE    => WHT (white)
  #define BLK_RGB 0x000000 // #000000 BLACK    => BLK (blak)

  //
  // color definitions from MoErgo
  // https://github.com/moergo-sc/zmk/blob/aca523dfce9b6447ffd19d833b791d44f1f286de/app/src/rgb_underglow.c#L259-L265
  //
  #define DUG_RGB 0x00ff68 // #00ff68 DULL_GRN => DUG (dull green)
  #define LAC_RGB 0x6b1fce // #6b1fce LILAC    => LAC (lilac)

  //
  // underglow for the colors above
  //
  #define RED &ug RED_RGB
  #define COR &ug COR_RGB
  #define ORN &ug ORN_RGB
  #define GDN &ug GDN_RGB
  #define GOL &ug GOL_RGB
  #define YLW &ug YLW_RGB
  #define CHU &ug CHU_RGB
  #define GRN &ug GRN_RGB
  #define SPG &ug SPG_RGB
  #define CYN &ug CYN_RGB
  #define AZU &ug AZU_RGB
  #define TEA &ug TEA_RGB
  #define TUR &ug TUR_RGB
  #define BLU &ug BLU_RGB
  #define PUR &ug PUR_RGB
  #define MAJ &ug MAJ_RGB
  #define PNK &ug PNK_RGB
  #define WHT &ug WHT_RGB
  #define BLK &ug BLK_RGB
  #define ___ &ug BLK_RGB
  #define DUG &ug DUG_RGB
  #define LAC &ug LAC_RGB

  //
  // underglow for keyboard locks on the Base layer
  //
  #define BSL &ug_sl LAC_RGB ORN_RGB // ScrollLock COLOR_OFF COLOR_ON
  #define BNL &ug_nl LAC_RGB ORN_RGB // NumLock    COLOR_OFF COLOR_ON
  #define BCL &ug_cl BLU_RGB ORN_RGB // CapsLock   COLOR_OFF COLOR_ON

  //
  // underglow for keyboard locks on the System layer
  //
  #define SSL &ug_sl BLK_RGB ORN_RGB // ScrollLock COLOR_OFF COLOR_ON
  #define SNL &ug_nl BLK_RGB ORN_RGB // NumLock    COLOR_OFF COLOR_ON
  #define SCL &ug_cl BLK_RGB ORN_RGB // CapsLock   COLOR_OFF COLOR_ON

  //
  // colors for mouse speed scaling in Mouse layers
  //
  #define FST GOL
  #define SLO PNK
  #define FIN COR
  #define WRP CHU

  // ==== PER-KEY-RGB <section begins> ====
  / {
    underglow-layer {
      compatible  = "zmk,underglow-layer";

      /*
      Template {
        bindings = <
          ___ ___ ___ ___ ___                                             ___ ___ ___ ___ ___
          ___ ___ ___ ___ ___ ___                                     ___ ___ ___ ___ ___ ___
          ___ ___ ___ ___ ___ ___                                     ___ ___ ___ ___ ___ ___
          ___ ___ ___ ___ ___ ___                                     ___ ___ ___ ___ ___ ___
          ___ ___ ___ ___ ___ ___     ___ ___ ___     ___ ___ ___     ___ ___ ___ ___ ___ ___
          ___ ___ ___ ___ ___         ___ ___ ___     ___ ___ ___         ___ ___ ___ ___ ___
        >;
        layer-id = <LAYER_Template>;
      };
      */

      BaseLayer {
        bindings = <
          RED ___ ___ ___ ___                                             ___ ___ ___ ___ ___
          ___ ___ ___ ___ ___ ___                                     ___ ___ ___ ___ ___ ___
          ___ ___ ___ ___ ___ ___                                     ___ ___ ___ ___ ___ ___
          ___ ___ ___ ___ ___ ___                                     ___ ___ ___ ___ ___ ___
          ___ ___ ___ ___ ___ ___     ___ ___ ___     ___ ___ ___     ___ ___ ___ ___ ___ ___
          ___ ___ ___ ___ ___         ___ ___ ___     ___ ___ ___         ___ ___ ___ ___ ___
        >;
        layer-id = <0>;
      };

      Mouse {
        bindings = <
          ___ MAJ ___ ___ ___                                             ___ ___ ___ ___ ___
          ___ ___ ___ ___ ___ ___                                     ___ ___ ___ ___ ___ ___
          ___ ___ ___ ___ ___ ___                                     ___ ___ ___ ___ ___ ___
          ___ ___ ___ ___ ___ ___                                     ___ ___ ___ ___ ___ ___
          ___ ___ ___ ___ ___ ___     ___ ___ ___     ___ ___ ___     ___ ___ ___ ___ ___ ___
          ___ ___ ___ ___ ___         ___ ___ ___     ___ ___ ___         ___ ___ ___ ___ ___
        >;
        layer-id = <LAYER_Mouse>;
      };

      Navigation {
        bindings = <
          ___ ___ CYN ___ ___                                             ___ ___ ___ ___ ___
          ___ ___ ___ ___ ___ ___                                     ___ ___ ___ ___ ___ ___
          ___ ___ ___ ___ ___ ___                                     ___ ___ ___ ___ ___ ___
          ___ ___ ___ ___ ___ ___                                     ___ ___ ___ ___ ___ ___
          ___ ___ ___ ___ ___ ___     ___ ___ ___     ___ ___ ___     ___ ___ ___ ___ ___ ___
          ___ ___ ___ ___ ___         ___ ___ ___     ___ ___ ___         ___ ___ ___ ___ ___
        >;
        layer-id = <LAYER_Navigation>;
      };

      Function {
        bindings = <
          ___ ___ ___ GRN ___                                             ___ ___ ___ ___ ___
          ___ ___ ___ ___ ___ ___                                     ___ ___ ___ ___ ___ ___
          ___ ___ ___ ___ ___ ___                                     ___ ___ ___ ___ ___ ___
          ___ ___ ___ ___ ___ ___                                     ___ ___ ___ ___ ___ ___
          ___ ___ ___ ___ ___ ___     ___ ___ ___     ___ ___ ___     ___ ___ ___ ___ ___ ___
          ___ ___ ___ ___ ___         ___ ___ ___     ___ ___ ___         ___ ___ ___ ___ ___
        >;
        layer-id = <LAYER_Function>;
      };

      Symbols {
        bindings = <
          ___ ___ ___ ___ YLW                                             ___ ___ ___ ___ ___
          ___ ___ ___ ___ ___ ___                                     ___ ___ ___ ___ ___ ___
          ___ ___ ___ ___ ___ ___                                     ___ ___ ___ ___ ___ ___
          ___ ___ ___ ___ ___ ___                                     ___ ___ ___ ___ ___ ___
          ___ ___ ___ ___ ___ ___     ___ ___ ___     ___ ___ ___     ___ ___ ___ ___ ___ ___
          ___ ___ ___ ___ ___         ___ ___ ___     ___ ___ ___         ___ ___ ___ ___ ___
        >;
        layer-id = <LAYER_Symbols>;
      };

      Numbers {
        bindings = <
          ___ ___ ___ ___ ___                                             YLW ___ ___ ___ ___
          ___ ___ ___ ___ ___ ___                                     ___ ___ ___ ___ ___ ___
          ___ ___ ___ ___ ___ ___                                     ___ ___ ___ ___ ___ ___
          ___ ___ ___ ___ ___ ___                                     ___ ___ ___ ___ ___ ___
          ___ ___ ___ ___ ___ ___     ___ ___ ___     ___ ___ ___     ___ ___ ___ ___ ___ ___
          ___ ___ ___ ___ ___         ___ ___ ___     ___ ___ ___         ___ ___ ___ ___ ___
        >;
        layer-id = <LAYER_Numbers>;
      };

/*      Magic {
        bindings = <
          ___ ___ ___ ___ ___                                             ___ ___ ___ ___ ___
          ___ ___ ___ ___ ___ ___                                     ___ ___ ___ ___ ___ ___
          ___ ___ ___ ___ ___ ___                                     ___ ___ ___ ___ ___ ___
          ___ ___ ___ ___ ___ ___                                     ___ ___ ___ ___ ___ ___
          ___ ___ ___ ___ ___ ___     ___ ___ RED     ___ ___ ___     ___ ___ ___ ___ ___ ___
          RED ___ ___ ___ ___         ___ ___ ___     ___ ___ ___         ___ ___ ___ ___ ___
        >;
        layer-id = <LAYER_Magic>;
      };
*/
    };
  };
  // ==== PER-KEY-RGB <section ends> =====

  #undef RED
  #undef RED_RGB
  #undef COR
  #undef COR_RGB
  #undef ORN
  #undef ORN_RGB
  #undef GDN
  #undef GDN_RGB
  #undef GOL
  #undef GOL_RGB
  #undef YLW
  #undef YLW_RGB
  #undef CHU
  #undef CHU_RGB
  #undef GRN
  #undef GRN_RGB
  #undef SPG
  #undef SPG_RGB
  #undef CYN
  #undef CYN_RGB
  #undef AZU
  #undef AZU_RGB
  #undef TEA
  #undef TEA_RGB
  #undef TUR
  #undef TUR_RGB
  #undef BLU
  #undef BLU_RGB
  #undef PUR
  #undef PUR_RGB
  #undef MAJ
  #undef MAJ_RGB
  #undef PNK
  #undef PNK_RGB
  #undef WHT
  #undef WHT_RGB
  #undef BLK
  #undef BLK_RGB
  #undef ___
  #undef DUG
  #undef DUG_RGB
  #undef LAC
  #undef LAC_RGB

  #undef BSL
  #undef BNL
  #undef BCL

  #undef SSL
  #undef SNL
  #undef SCL

  #undef FST
  #undef WRP
  #undef SLO
  #undef FIN
#endif


/* Input Listeners */


/* System behavior and Macros */
/ {
    behaviors {
        ZMK_TD_LAYER(lower, LAYER_Lower)
    };
};

/ {
    macros {
        rgb_ug_status_macro: rgb_ug_status_macro {
            label = "RGB_UG_STATUS";
            compatible = "zmk,behavior-macro";
            #binding-cells = <0>;
            bindings
                = <&rgb_ug RGB_STATUS>;
        };
    };
};

/{

//////////////////////////////////////////////////////////////////////////
//
// Mouse keys (keyboard mouse control) requires v24.12 firmware or newer:
// override the "HID_POINTING" setting to "y" in Advanced Configuration
// and then select "v24.12" firmware from the drop-down menu located at
// Glove80 Layout Editor > Settings > Advanced Settings > Firmware Version
//
// Alternatively, you can use either PR36 or PR23 beta firmware for this:
// select "community.pr36.mouse-keys" from the drop-down menu located at
// Glove80 Layout Editor > Settings > Advanced Settings > Firmware Version
//
// - https://github.com/moergo-sc/zmk/pull/36
// - https://github.com/moergo-sc/zmk/pull/23
// - https://gist.github.com/krissen/dd27082e7ab0575619c7a31f4d2ec7ae
// - https://github.com/zmkfirmware/zmk/compare/main...urob:zmk:mouse-3.2
// - https://github.com/caksoylar/zmk-config/commit/0020c23c544cd7111013f0114609d1fb90e0e475
// - https://github.com/caksoylar/zmk-config/commit/e35ee2f08788927683df7bbdd7fc73434473886e
//
//////////////////////////////////////////////////////////////////////////

//
// NATURAL_SCROLLING reverses the directionality of the mouse scroll wheel
// to support "natural scrolling" in macOS and other desktop environments.
//
//#define NATURAL_SCROLLING

#ifdef NATURAL_SCROLLING
  #define MOUSE_SCROLL_UP    SCRL_DOWN
  #define MOUSE_SCROLL_DOWN  SCRL_UP
  #define MOUSE_SCROLL_LEFT  SCRL_RIGHT
  #define MOUSE_SCROLL_RIGHT SCRL_LEFT
#else
  #define MOUSE_SCROLL_UP    SCRL_UP
  #define MOUSE_SCROLL_DOWN  SCRL_DOWN
  #define MOUSE_SCROLL_LEFT  SCRL_LEFT
  #define MOUSE_SCROLL_RIGHT SCRL_RIGHT
#endif

//
// MOUSE_MOTION_DELAY defines how long to wait (milliseconds) before starting
// to move the mouse pointer.
//
#ifndef MOUSE_MOTION_DELAY
#define MOUSE_MOTION_DELAY 0
#endif

//
// MOUSE_MOTION_ACCELERATION_EXPONENT sets how the mouse pointer accelerates:
//
// acceleration exponent 0: uniform speed
// acceleration exponent 1: uniform acceleration
// acceleration exponent 2: uniform jerk
//
#ifndef MOUSE_MOTION_ACCELERATION_EXPONENT
#define MOUSE_MOTION_ACCELERATION_EXPONENT 1
#endif

//
// MOUSE_MOTION_TIME_TO_MAXIMUM_SPEED defines how long to wait (milliseconds)
// before the mouse pointer speed is suddenly boosted to the maximum value.
//
#ifndef MOUSE_MOTION_TIME_TO_MAXIMUM_SPEED
#define MOUSE_MOTION_TIME_TO_MAXIMUM_SPEED 300
#endif

//
// MOUSE_MOTION_MAXIMUM_SPEED defines how quickly the mouse pointer can move.
//
#ifndef MOUSE_MOTION_MAXIMUM_SPEED
#define MOUSE_MOTION_MAXIMUM_SPEED 600
#endif

//
// MOUSE_SCROLL_DELAY defines how long to wait (milliseconds) before starting
// to move the mouse pointer.
//
#ifndef MOUSE_SCROLL_DELAY
#define MOUSE_SCROLL_DELAY 0
#endif

//
// MOUSE_SCROLL_ACCELERATION_EXPONENT sets how the mouse pointer accelerates:
//
// acceleration exponent 0: uniform speed
// acceleration exponent 1: uniform acceleration
// acceleration exponent 2: uniform jerk
//
#ifndef MOUSE_SCROLL_ACCELERATION_EXPONENT
#define MOUSE_SCROLL_ACCELERATION_EXPONENT 0
#endif

//
// MOUSE_SCROLL_TIME_TO_MAXIMUM_SPEED defines how long to wait (milliseconds)
// before the mouse pointer speed is suddenly boosted to the maximum value.
//
#ifndef MOUSE_SCROLL_TIME_TO_MAXIMUM_SPEED
#define MOUSE_SCROLL_TIME_TO_MAXIMUM_SPEED 300
#endif

//
// MOUSE_SCROLL_MAXIMUM_SPEED defines how quickly the mouse wheel can scroll.
//
#ifndef MOUSE_SCROLL_MAXIMUM_SPEED
#define MOUSE_SCROLL_MAXIMUM_SPEED 10
#endif

//
// MOUSE_SCALER_FINE sets parameters for the &zip_xy_scaler input processor:
// https://zmk.dev/docs/keymaps/input-processors/scaler
//
#ifndef MOUSE_SCALER_FINE
#define MOUSE_SCALER_FINE 1 16
#endif

//
// MOUSE_SCALER_SLOW sets parameters for the &zip_xy_scaler input processor:
// https://zmk.dev/docs/keymaps/input-processors/scaler
//
#ifndef MOUSE_SCALER_SLOW
#define MOUSE_SCALER_SLOW 1 4
#endif

//
// MOUSE_SCALER_FAST sets parameters for the &zip_xy_scaler input processor:
// https://zmk.dev/docs/keymaps/input-processors/scaler
//
#ifndef MOUSE_SCALER_FAST
#define MOUSE_SCALER_FAST 4 1
#endif

//
// MOUSE_SCALER_WARP sets parameters for the &zip_xy_scaler input processor:
// https://zmk.dev/docs/keymaps/input-processors/scaler
//
#ifndef MOUSE_SCALER_WARP
#define MOUSE_SCALER_WARP 12 1
#endif
/*HACK*/};

#ifdef ENABLE_MOUSE_KEYS
  // ==== MOUSE-KEY <section begins> ====
  #define ZMK_POINTING_DEFAULT_MOVE_VAL MOUSE_MOTION_MAXIMUM_SPEED
  #define ZMK_POINTING_DEFAULT_SCRL_VAL MOUSE_SCROLL_MAXIMUM_SPEED
  #include <dt-bindings/zmk/pointing.h>
  &mmv {
    delay-ms = <MOUSE_MOTION_DELAY>;
    acceleration-exponent = <MOUSE_MOTION_ACCELERATION_EXPONENT>;
    time-to-max-speed-ms = <MOUSE_MOTION_TIME_TO_MAXIMUM_SPEED>;
  };
  &msc {
    delay-ms = <MOUSE_SCROLL_DELAY>;
    acceleration-exponent = <MOUSE_SCROLL_ACCELERATION_EXPONENT>;
    time-to-max-speed-ms = <MOUSE_SCROLL_TIME_TO_MAXIMUM_SPEED>;
  };
  //
  // Scaling for mouse movement, based on @caksoylar's example:
  // https://github.com/caksoylar/zmk-config/commit/0020c23c544cd7111013f0114609d1fb90e0e475
  //
  #include <input/processors.dtsi>
  &mmv_input_listener {
    #ifdef LAYER_MouseFine
    fine {
      layers = <LAYER_MouseFine>;
      input-processors = <&zip_xy_scaler MOUSE_SCALER_FINE>;
    };
    #endif
    #ifdef LAYER_MouseSlow
    slow {
      layers = <LAYER_MouseSlow>;
      input-processors = <&zip_xy_scaler MOUSE_SCALER_SLOW>;
    };
    #endif
    #ifdef LAYER_MouseFast
    fast {
      layers = <LAYER_MouseFast>;
      input-processors = <&zip_xy_scaler MOUSE_SCALER_FAST>;
    };
    #endif
    #ifdef LAYER_MouseWarp
    warp {
      layers = <LAYER_MouseWarp>;
      input-processors = <&zip_xy_scaler MOUSE_SCALER_WARP>;
    };
    #endif
  };
  //
  // Scaling for mouse scrolling, based on @caksoylar's example:
  // https://github.com/caksoylar/zmk-config/commit/e35ee2f08788927683df7bbdd7fc73434473886e
  //
  #include <zephyr/dt-bindings/input/input-event-codes.h>
  / {
    input_processors {
      zip_scroll_scaling_processor: zip_scroll_scaling_processor {
        compatible = "zmk,input-processor-scaler";
        #input-processor-cells = <2>;
        type = <INPUT_EV_REL>;
        codes = <INPUT_REL_WHEEL INPUT_REL_HWHEEL>;
        track-remainders;
      };
    };
  };
  &msc_input_listener {
    #ifdef LAYER_MouseFine
    fine {
      layers = <LAYER_MouseFine>;
      input-processors = <&zip_scroll_scaling_processor MOUSE_SCALER_FINE>;
    };
    #endif
    #ifdef LAYER_MouseSlow
    slow {
      layers = <LAYER_MouseSlow>;
      input-processors = <&zip_scroll_scaling_processor MOUSE_SCALER_SLOW>;
    };
    #endif
    #ifdef LAYER_MouseFast
    fast {
      layers = <LAYER_MouseFast>;
      input-processors = <&zip_scroll_scaling_processor MOUSE_SCALER_FAST>;
    };
    #endif
    #ifdef LAYER_MouseWarp
    warp {
      layers = <LAYER_MouseWarp>;
      input-processors = <&zip_scroll_scaling_processor MOUSE_SCALER_WARP>;
    };
    #endif
  };
  // ==== MOUSE-KEY <section ends> =====
#else
  #define mkp none
  #define mmv none
  #define msc none
  #define LCLK
  #define MCLK
  #define RCLK
  #define MB1
  #define MB2
  #define MB3
  #define MB4
  #define MB5
  #define MOVE_UP
  #define MOVE_DOWN
  #define MOVE_LEFT
  #define MOVE_RIGHT
  #define SCRL_UP
  #define SCRL_DOWN
  #define SCRL_LEFT
  #define SCRL_RIGHT
#endif


/ {
#ifdef BT_DISC_CMD
    behaviors {
        bt_0: bt_0 {
            compatible = "zmk,behavior-tap-dance";
            label = "BT_0";
            #binding-cells = <0>;
            tapping-term-ms = <200>;
            bindings = <&bt_select_0>, <&bt BT_DISC 0>;
        };
        bt_1: bt_1 {
            compatible = "zmk,behavior-tap-dance";
            label = "BT_1";
            #binding-cells = <0>;
            tapping-term-ms = <200>;
            bindings = <&bt_select_1>, <&bt BT_DISC 1>;
        };
        bt_2: bt_2 {
            compatible = "zmk,behavior-tap-dance";
            label = "BT_2";
            #binding-cells = <0>;
            tapping-term-ms = <200>;
            bindings = <&bt_select_2>, <&bt BT_DISC 2>;
        };
        bt_3: bt_3 {
            compatible = "zmk,behavior-tap-dance";
            label = "BT_3";
            #binding-cells = <0>;
            tapping-term-ms = <200>;
            bindings = <&bt_select_3>, <&bt BT_DISC 3>;
        };
    };
    macros {
        bt_select_0: bt_select_0 {
            label = "BT_SELECT_0";
            compatible = "zmk,behavior-macro";
            #binding-cells = <0>;
            bindings
                = <&out OUT_BLE>,
                  <&bt BT_SEL 0>;
        };
        bt_select_1: bt_select_1 {
            label = "BT_SELECT_1";
            compatible = "zmk,behavior-macro";
            #binding-cells = <0>;
            bindings
                = <&out OUT_BLE>,
                  <&bt BT_SEL 1>;
        };
        bt_select_2: bt_select_2 {
            label = "BT_SELECT_2";
            compatible = "zmk,behavior-macro";
            #binding-cells = <0>;
            bindings
                = <&out OUT_BLE>,
                  <&bt BT_SEL 2>;
        };
        bt_select_3: bt_select_3 {
            label = "BT_SELECT_3";
            compatible = "zmk,behavior-macro";
            #binding-cells = <0>;
            bindings
                = <&out OUT_BLE>,
                  <&bt BT_SEL 3>;
        };
    };
#else
    macros {
        bt_0: bt_0 {
            label = "BT_0";
            compatible = "zmk,behavior-macro";
            #binding-cells = <0>;
            bindings
                = <&out OUT_BLE>,
                  <&bt BT_SEL 0>;
        };
        bt_1: bt_1 {
            label = "BT_1";
            compatible = "zmk,behavior-macro";
            #binding-cells = <0>;
            bindings
                = <&out OUT_BLE>,
                  <&bt BT_SEL 1>;
        };
        bt_2: bt_2 {
            label = "BT_2";
            compatible = "zmk,behavior-macro";
            #binding-cells = <0>;
            bindings
                = <&out OUT_BLE>,
                  <&bt BT_SEL 2>;
        };
        bt_3: bt_3 {
            label = "BT_3";
            compatible = "zmk,behavior-macro";
            #binding-cells = <0>;
            bindings
                = <&out OUT_BLE>,
                  <&bt BT_SEL 3>;
        };
    };
#endif
};

/ {
    behaviors {
        magic: magic {
            compatible = "zmk,behavior-hold-tap";
            label = "MAGIC_HOLD_TAP";
            #binding-cells = <2>;
            flavor = "tap-preferred";
            tapping-term-ms = <200>;
            bindings = <&mo>, <&rgb_ug_status_macro>;
        };
    };
};


/* Key positions */

#define POS_LH_C6R1 0
#define POS_LH_C5R1 1
#define POS_LH_C4R1 2
#define POS_LH_C3R1 3
#define POS_LH_C2R1 4
#define POS_RH_C2R1 5
#define POS_RH_C3R1 6
#define POS_RH_C4R1 7
#define POS_RH_C5R1 8
#define POS_RH_C6R1 9
#define POS_LH_C6R2 10
#define POS_LH_C5R2 11
#define POS_LH_C4R2 12
#define POS_LH_C3R2 13
#define POS_LH_C2R2 14
#define POS_LH_C1R2 15
#define POS_RH_C1R2 16
#define POS_RH_C2R2 17
#define POS_RH_C3R2 18
#define POS_RH_C4R2 19
#define POS_RH_C5R2 20
#define POS_RH_C6R2 21
#define POS_LH_C6R3 22
#define POS_LH_C5R3 23
#define POS_LH_C4R3 24
#define POS_LH_C3R3 25
#define POS_LH_C2R3 26
#define POS_LH_C1R3 27
#define POS_RH_C1R3 28
#define POS_RH_C2R3 29
#define POS_RH_C3R3 30
#define POS_RH_C4R3 31
#define POS_RH_C5R3 32
#define POS_RH_C6R3 33
#define POS_LH_C6R4 34
#define POS_LH_C5R4 35
#define POS_LH_C4R4 36
#define POS_LH_C3R4 37
#define POS_LH_C2R4 38
#define POS_LH_C1R4 39
#define POS_RH_C1R4 40
#define POS_RH_C2R4 41
#define POS_RH_C3R4 42
#define POS_RH_C4R4 43
#define POS_RH_C5R4 44
#define POS_RH_C6R4 45
#define POS_LH_C6R5 46
#define POS_LH_C5R5 47
#define POS_LH_C4R5 48
#define POS_LH_C3R5 49
#define POS_LH_C2R5 50
#define POS_LH_C1R5 51
#define POS_LH_T1 52
#define POS_LH_T2 53
#define POS_LH_T3 54
#define POS_RH_T3 55
#define POS_RH_T2 56
#define POS_RH_T1 57
#define POS_RH_C1R5 58
#define POS_RH_C2R5 59
#define POS_RH_C3R5 60
#define POS_RH_C4R5 61
#define POS_RH_C5R5 62
#define POS_RH_C6R5 63
#define POS_LH_C6R6 64
#define POS_LH_C5R6 65
#define POS_LH_C4R6 66
#define POS_LH_C3R6 67
#define POS_LH_C2R6 68
#define POS_LH_T4 69
#define POS_LH_T5 70
#define POS_LH_T6 71
#define POS_RH_T6 72
#define POS_RH_T5 73
#define POS_RH_T4 74
#define POS_RH_C2R6 75
#define POS_RH_C3R6 76
#define POS_RH_C4R6 77
#define POS_RH_C5R6 78
#define POS_RH_C6R6 79


/* Custom Defined Behaviors */
/ {

};

/* Generated input processors */


/* Automatically generated macro definitions */
/ {
    macros {

    };
};

/* Automatically generated behavior definitions */
/ {
    behaviors {


        // Homerow Mod for the left index finger - TailorKey.
        // For advanced tuning of HRM values, see: https://docs.google.com/spreadsheets/d/1ESgObQelyz4lnKlfwLYsmofLJulOMK5RdGBsopLe2o8
        HRM_left_index_v1_TKZ: HRM_left_index_v1_TKZ {
            compatible = "zmk,behavior-hold-tap";
            #binding-cells = <2>;
            tapping-term-ms = <190>;
            bindings = <&kp>, <&kp>;
            flavor = "tap-preferred";
            quick-tap-ms = <300>;
            require-prior-idle-ms = <100>;
            hold-trigger-key-positions = <POS_RH_T6 POS_RH_T5 POS_RH_T4 POS_RH_C1R2 POS_RH_C2R2 POS_RH_C3R2 POS_RH_C4R2 POS_RH_C5R2 POS_RH_C1R3 POS_RH_C2R3 POS_RH_C3R3 POS_RH_C4R3 POS_RH_C5R3 POS_RH_C1R4 POS_RH_C2R4 POS_RH_C3R4 POS_RH_C4R4 POS_RH_C5R4 POS_RH_C1R5 POS_RH_C2R5 POS_RH_C3R5 POS_RH_C4R5 POS_RH_C5R5 POS_RH_C2R6 POS_RH_C3R6 POS_RH_C4R6 POS_RH_C6R2 POS_RH_C6R3 POS_RH_C6R4 POS_RH_C6R5 POS_LH_T5 POS_LH_T6 POS_LH_T4>;
            hold-trigger-on-release;
        };

        // Homerow Mod for the left middle finger - TailorKey
        HRM_left_middy_v1_TKZ: HRM_left_middy_v1_TKZ {
            compatible = "zmk,behavior-hold-tap";
            #binding-cells = <2>;
            tapping-term-ms = <210>;
            bindings = <&kp>, <&kp>;
            flavor = "tap-preferred";
            quick-tap-ms = <300>;
            require-prior-idle-ms = <150>;
            hold-trigger-key-positions = <POS_RH_T6 POS_RH_T5 POS_RH_T4 POS_RH_C1R2 POS_RH_C2R2 POS_RH_C3R2 POS_RH_C4R2 POS_RH_C5R2 POS_RH_C1R3 POS_RH_C2R3 POS_RH_C3R3 POS_RH_C4R3 POS_RH_C5R3 POS_RH_C1R4 POS_RH_C2R4 POS_RH_C3R4 POS_RH_C4R4 POS_RH_C5R4 POS_RH_C1R5 POS_RH_C2R5 POS_RH_C3R5 POS_RH_C4R5 POS_RH_C5R5 POS_RH_C2R6 POS_RH_C3R6 POS_RH_C4R6 POS_RH_C6R2 POS_RH_C6R3 POS_RH_C6R4 POS_RH_C6R5 POS_LH_T4 POS_LH_T5 POS_LH_T6>;
            hold-trigger-on-release;
        };

        // Homerow Mod for the left pinky - TailorKey
        HRM_left_pinky_v1_TKZ: HRM_left_pinky_v1_TKZ {
            compatible = "zmk,behavior-hold-tap";
            #binding-cells = <2>;
            tapping-term-ms = <260>;
            bindings = <&kp>, <&kp>;
            flavor = "tap-preferred";
            quick-tap-ms = <300>;
            require-prior-idle-ms = <150>;
            hold-trigger-key-positions = <POS_RH_T6 POS_RH_T5 POS_RH_T4 POS_RH_C1R2 POS_RH_C2R2 POS_RH_C3R2 POS_RH_C4R2 POS_RH_C5R2 POS_RH_C6R2 POS_RH_C2R3 POS_RH_C3R3 POS_RH_C4R3 POS_RH_C5R3 POS_RH_C6R3 POS_RH_C3R4 POS_RH_C4R4 POS_RH_C5R4 POS_RH_C6R4 POS_RH_C3R5 POS_RH_C4R5 POS_RH_C5R5 POS_RH_C6R5 POS_RH_C1R3 POS_RH_C1R4 POS_RH_C2R4 POS_RH_C1R5 POS_RH_C2R5 POS_RH_C2R6 POS_RH_C3R6 POS_RH_C4R6 POS_LH_T4 POS_LH_T5 POS_LH_T6>;
            hold-trigger-on-release;
        };

        // Homerow Mod for the left ring finger 1 - TailorKey
        HRM_left_ring_v1_TKZ: HRM_left_ring_v1_TKZ {
            compatible = "zmk,behavior-hold-tap";
            #binding-cells = <2>;
            tapping-term-ms = <240>;
            bindings = <&kp>, <&kp>;
            flavor = "tap-preferred";
            quick-tap-ms = <300>;
            require-prior-idle-ms = <150>;
            hold-trigger-key-positions = <POS_RH_T6 POS_RH_T5 POS_RH_T4 POS_RH_C1R2 POS_RH_C2R2 POS_RH_C3R2 POS_RH_C4R2 POS_RH_C5R2 POS_RH_C1R3 POS_RH_C2R3 POS_RH_C3R3 POS_RH_C4R3 POS_RH_C5R3 POS_RH_C1R4 POS_RH_C2R4 POS_RH_C3R4 POS_RH_C4R4 POS_RH_C5R4 POS_RH_C1R5 POS_RH_C2R5 POS_RH_C3R5 POS_RH_C4R5 POS_RH_C5R5 POS_RH_C2R6 POS_RH_C3R6 POS_RH_C4R6 POS_RH_C6R2 POS_RH_C6R3 POS_RH_C6R4 POS_RH_C6R5 POS_LH_T4 POS_LH_T5 POS_LH_T6>;
            hold-trigger-on-release;
        };

        // Homerow Mod for the right index finger - TailorKey
        HRM_right_index_v1_TKZ: HRM_right_index_v1_TKZ {
            compatible = "zmk,behavior-hold-tap";
            #binding-cells = <2>;
            tapping-term-ms = <190>;
            bindings = <&kp>, <&kp>;
            flavor = "tap-preferred";
            quick-tap-ms = <300>;
            require-prior-idle-ms = <100>;
            hold-trigger-key-positions = <POS_LH_T6 POS_LH_T5 POS_LH_T4 POS_LH_C6R2 POS_LH_C5R2 POS_LH_C4R2 POS_LH_C3R2 POS_LH_C2R2 POS_LH_C6R3 POS_LH_C5R3 POS_LH_C4R3 POS_LH_C3R3 POS_LH_C2R3 POS_LH_C1R3 POS_LH_C6R4 POS_LH_C5R4 POS_LH_C4R4 POS_LH_C3R4 POS_LH_C2R4 POS_LH_C1R4 POS_LH_C6R5 POS_LH_C5R5 POS_LH_C4R5 POS_LH_C3R5 POS_LH_C2R5 POS_LH_C1R5 POS_LH_C4R6 POS_LH_C3R6 POS_LH_C2R6 POS_LH_C1R2 POS_RH_T6 POS_RH_T5 POS_RH_T4>;
            hold-trigger-on-release;
        };

        // Homerow Mod for the right middle finger - TailorKey
        HRM_right_middy_v1_TKZ: HRM_right_middy_v1_TKZ {
            compatible = "zmk,behavior-hold-tap";
            #binding-cells = <2>;
            tapping-term-ms = <210>;
            bindings = <&kp>, <&kp>;
            flavor = "tap-preferred";
            quick-tap-ms = <300>;
            require-prior-idle-ms = <150>;
            hold-trigger-key-positions = <POS_LH_T6 POS_LH_T5 POS_LH_T4 POS_LH_C6R2 POS_LH_C5R2 POS_LH_C4R2 POS_LH_C3R2 POS_LH_C2R2 POS_LH_C6R3 POS_LH_C5R3 POS_LH_C4R3 POS_LH_C3R3 POS_LH_C2R3 POS_LH_C1R3 POS_LH_C6R4 POS_LH_C5R4 POS_LH_C4R4 POS_LH_C3R4 POS_LH_C2R4 POS_LH_C1R4 POS_LH_C6R5 POS_LH_C5R5 POS_LH_C4R5 POS_LH_C3R5 POS_LH_C2R5 POS_LH_C1R5 POS_LH_C4R6 POS_LH_C3R6 POS_LH_C2R6 POS_LH_C1R2 POS_RH_T6 POS_RH_T5 POS_RH_T4>;
            hold-trigger-on-release;
        };

        // Homerow Mod for the right pinky - TailorKey
        HRM_right_pinky_v1_TKZ: HRM_right_pinky_v1_TKZ {
            compatible = "zmk,behavior-hold-tap";
            #binding-cells = <2>;
            tapping-term-ms = <260>;
            bindings = <&kp>, <&kp>;
            flavor = "tap-preferred";
            quick-tap-ms = <300>;
            require-prior-idle-ms = <150>;
            hold-trigger-key-positions = <POS_LH_T6 POS_LH_T5 POS_LH_T4 POS_LH_C6R2 POS_LH_C5R2 POS_LH_C4R2 POS_LH_C3R2 POS_LH_C2R2 POS_LH_C6R3 POS_LH_C5R3 POS_LH_C4R3 POS_LH_C3R3 POS_LH_C2R3 POS_LH_C1R3 POS_LH_C6R4 POS_LH_C5R4 POS_LH_C4R4 POS_LH_C3R4 POS_LH_C2R4 POS_LH_C1R4 POS_LH_C6R5 POS_LH_C5R5 POS_LH_C4R5 POS_LH_C3R5 POS_LH_C2R5 POS_LH_C1R5 POS_LH_C4R6 POS_LH_C3R6 POS_LH_C2R6 POS_LH_C1R2 POS_RH_T6 POS_RH_T5 POS_RH_T4>;
            hold-trigger-on-release;
        };

        // Homerow Mod for the right ring 1 - TailorKey
        //
        HRM_right_ring_v1_TKZ: HRM_right_ring_v1_TKZ {
            compatible = "zmk,behavior-hold-tap";
            #binding-cells = <2>;
            tapping-term-ms = <240>;
            bindings = <&kp>, <&kp>;
            flavor = "tap-preferred";
            quick-tap-ms = <300>;
            require-prior-idle-ms = <150>;
            hold-trigger-key-positions = <POS_LH_T6 POS_LH_T5 POS_LH_T4 POS_LH_C6R2 POS_LH_C5R2 POS_LH_C4R2 POS_LH_C3R2 POS_LH_C2R2 POS_LH_C6R3 POS_LH_C5R3 POS_LH_C4R3 POS_LH_C3R3 POS_LH_C2R3 POS_LH_C1R3 POS_LH_C6R4 POS_LH_C5R4 POS_LH_C4R4 POS_LH_C3R4 POS_LH_C2R4 POS_LH_C1R4 POS_LH_C6R5 POS_LH_C5R5 POS_LH_C4R5 POS_LH_C3R5 POS_LH_C2R5 POS_LH_C1R5 POS_LH_C4R6 POS_LH_C3R6 POS_LH_C2R6 POS_LH_C1R2 POS_RH_T6 POS_RH_T5 POS_RH_T4>;
            hold-trigger-on-release;
        };

        // space_layer_access - TailorKey
        space_v3_TKZ: space_v3_TKZ {
            compatible = "zmk,behavior-hold-tap";
            #binding-cells = <2>;
            tapping-term-ms = <200>;
            bindings = <&mo>, <&kp>;
            flavor = "balanced";
            quick-tap-ms = <150>;
        };

        // thumb_layer_access - TailorKey
        thumb_v2_TKZ: thumb_v2_TKZ {
            compatible = "zmk,behavior-hold-tap";
            #binding-cells = <2>;
            tapping-term-ms = <200>;
            bindings = <&mo>, <&kp>;
            flavor = "balanced";
            quick-tap-ms = <300>;
        };
    };
};

/* Automatically generated combos definitions */


/* Automatically generated keymap */
/ {
    keymap {
        compatible = "zmk,keymap";


        layer_Base {
            bindings = <
                &none                          &none                         &none                           &none                              &none                                                                                                                                                                                                   &none                            &none                          &none                           &none    &none
                &none                          &none                         &none                           &none                              &none  &none                                                                                                                                                          &none                             &none                            &none                          &none                           &none    &none
                &none                          &kp Q                         &kp W                           &kp E                              &kp R  &kp T                                                                                                                                                          &kp Y                             &kp U                            &kp I                          &kp O                           &kp P    &none
                &none  &HRM_left_pinky_v1_TKZ LGUI A  &HRM_left_ring_v1_TKZ LALT S  &HRM_left_middy_v1_TKZ LCTRL D     &HRM_left_index_v1_TKZ LSHFT F  &kp G                                                                                                                                                          &kp H   &HRM_right_index_v1_TKZ RSHFT J  &HRM_right_middy_v1_TKZ RCTRL K  &HRM_right_ring_v1_TKZ LALT L  &HRM_right_pinky_v1_TKZ RGUI SEMI &none
 &magic LAYER_Magic 0                          &kp Z                         &kp X                           &kp C                              &kp V  &kp B                                  &none                               &none  &none &none                           &none                            &none &kp N                             &kp M                        &kp COMMA                        &kp DOT                        &kp FSLH    &none
                &none                          &none                         &none                           &none   &thumb_v2_TKZ LAYER_Function ESC          &thumb_v2_TKZ LAYER_Navigation SPACE       &thumb_v2_TKZ LAYER_Mouse TAB  &none &none &thumb_v2_TKZ LAYER_Symbols RET  &thumb_v2_TKZ LAYER_Numbers DEL        &thumb_v2_TKZ LAYER_Symbols BSPC                            &none                          &none                          &none     &none
            >;
        };

        layer_Navigation {
            bindings = <
     &none      &none       &none       &none      &none                                                                                          &none       &none      &none       &none      &none
     &none      &none       &none       &none      &none          &none                                                              &none        &none       &none      &none       &none      &none
     &none      &none       &none       &none      &none          &none                                                         &kp K_REDO  &kp K_PASTE  &kp K_COPY  &kp K_CUT  &kp K_UNDO      &none
     &none   &kp LGUI    &kp LALT   &kp LCTRL  &kp LSHFT          &none                                                           &kp LEFT     &kp DOWN      &kp UP  &kp RIGHT    &kp CAPS      &none
     &none      &none       &none       &none      &none          &none    &none    &none   &none   &none     &none      &none    &kp HOME    &kp PG_DN   &kp PG_UP    &kp END     &kp INS      &none
     &none      &none       &none       &none      &none                 &kp TAB  &kp DEL   &none   &none   &kp RET   &kp BSPC                &kp DEL     &none   &none       &none      &none
            >;
        };

        layer_Symbols {
            bindings = <
  &none                &none       &none       &none       &none                                                                                                        &none      &none     &none     &none   &none
  &none                &none       &none       &none       &none          &none                                                                              &none      &none      &none     &none     &none   &none
  &none         &kp LS(LBKT)  &kp LS(N7)  &kp LS(N8)  &kp LS(N9)   &kp LS(RBKT)                                                                              &none      &none      &none     &none     &none   &none
  &none         &kp LS(SEMI)  &kp LS(N4)  &kp LS(N5)  &kp LS(N6)  &kp LS(EQUAL)                                                                              &none  &kp RSHFT  &kp RCTRL  &kp LALT  &kp RGUI   &none
  &none  &kp LS(NON_US_HASH)  &kp LS(N1)  &kp LS(N2)  &kp LS(N3)   &kp LS(BSLH)        &none          &none   &none       &none       &none          &none   &none      &none      &none     &none     &none   &none
  &none                &none       &none       &none  &kp LS(N9)                  &kp LS(N0)  &kp LS(MINUS)   &none       &none       &none          &none              &none      &none     &none     &none   &none
            >;
        };

        layer_Numbers {
            bindings = <
  &none      &none   &none   &none    &none                                                                            &none      &none     &none     &none   &none
  &none      &none   &none   &none    &none      &none                                                      &none      &none      &none     &none     &none   &none
  &none   &kp LBKT  &kp N7  &kp N8   &kp N9   &kp RBKT                                                      &none      &none      &none     &none     &none   &none
  &none   &kp SEMI  &kp N4  &kp N5   &kp N6  &kp EQUAL                                                      &none  &kp RSHFT  &kp RCTRL  &kp LALT  &kp RGUI   &none
  &none  &kp GRAVE  &kp N1  &kp N2   &kp N3   &kp BSLH   &none      &none  &none    &none   &none   &none   &none      &none      &none     &none     &none   &none
  &none      &none   &none   &none  &kp DOT             &kp N0  &kp MINUS  &none    &none   &none   &none              &none      &none     &none     &none   &none
            >;
        };

        layer_Function {
            bindings = <
  &none    &none   &none   &none      &none                                                                     &none      &none     &none     &none   &none
  &none    &none   &none   &none      &none      &none                                               &none      &none      &none     &none     &none   &none
  &none  &kp F12  &kp F7  &kp F8     &kp F9  &kp PSCRN                                               &none      &none      &none     &none     &none   &none
  &none  &kp F11  &kp F4  &kp F5     &kp F6   &kp SLCK                                               &none  &kp RSHFT  &kp RCTRL  &kp LALT  &kp RGUI   &none
  &none  &kp F10  &kp F1  &kp F2     &kp F3   &kp K_PP      &none    &none &none &none &none &none   &none      &none      &none     &none     &none   &none
  &none    &none   &none   &none  &kp K_APP             &kp SPACE  &kp DEL &none &none &none &none              &none      &none     &none     &none   &none
            >;
        };

        layer_Magic {
            bindings = <
  &bt BT_CLR            &none            &none            &none            &none                                                                                  &none   &none   &none   &none  &bt BT_CLR_ALL
       &none            &none            &none            &none            &none            &none                                                         &none   &none   &none   &none   &none           &none
       &none  &rgb_ug RGB_SPI  &rgb_ug RGB_SAI  &rgb_ug RGB_HUI  &rgb_ug RGB_BRI  &rgb_ug RGB_TOG                                                         &none   &none   &none   &none   &none           &none
 &bootloader  &rgb_ug RGB_SPD  &rgb_ug RGB_SAD  &rgb_ug RGB_HUD  &rgb_ug RGB_BRD  &rgb_ug RGB_EFF                                                         &none   &none   &none   &none   &none     &bootloader
  &sys_reset            &none            &none            &none            &none            &none   &bt_2   &bt_3         &none   &none   &none   &none   &none   &none   &none   &none   &none      &sys_reset
       &none            &none            &none            &none            &none                    &bt_0   &bt_1  &out OUT_USB   &none   &none   &none           &none   &none   &none   &none           &none
            >;
        };

  /*       layer_Mouse { */
  /*           bindings = < */
  /* &none     &none     &none      &none      &none                                                                                            &none           &none            &none       &none   &none */
  /* &none     &none     &none      &none      &none   &none                                                                    &none           &none           &none            &none       &none   &none */
  /* &none     &none     &none      &none      &none   &none                                                               &kp K_REDO     &kp K_PASTE      &kp K_COPY        &kp K_CUT  &kp K_UNDO   &none */
  /* &none  &kp LGUI  &kp LALT  &kp LCTRL  &kp LSHFT   &none                                                           &mmv MOVE_LEFT  &mmv MOVE_DOWN    &mmv MOVE_UP  &mmv MOVE_RIGHT       &none   &none */
  /* &none     &none     &none      &none      &none   &none   &none   &none   &none   &none       &none       &none  &msc SCRL_RIGHT    &msc SCRL_UP  &msc SCRL_DOWN   &msc SCRL_LEFT       &none   &none */
  /* &none     &none     &none      &none      &none           &none   &none   &none   &none   &mkp RCLK   &mkp LCLK                        &mkp MCLK           &none            &none       &none   &none */
  /*           >; */
  /*       }; */
        layer_Mouse {
            bindings = <
  &none                &none                &none                &none                &none                                                                                                &none           &none            &none       &none   &none
  &none                &none                &none                &none                &none   &none                                                                        &none           &none           &none            &none       &none   &none
  &none                &none                &none                &none                &none   &none                                                                   &kp K_REDO     &kp K_PASTE      &kp K_COPY        &kp K_CUT  &kp K_UNDO   &none
  &none             &kp LGUI             &kp LALT            &kp LCTRL            &kp LSHFT   &none                                                               &mmv MOVE_LEFT  &mmv MOVE_DOWN    &mmv MOVE_UP  &mmv MOVE_RIGHT       &none   &none
  &none  &mo LAYER_MouseWarp  &mo LAYER_MouseFine  &mo LAYER_MouseSlow  &mo LAYER_MouseFast   &none   &none  &none   &none       &none       &none       &none   &msc SCRL_RIGHT    &msc SCRL_UP  &msc SCRL_DOWN   &msc SCRL_LEFT       &none   &none
  &none                &none                &none                &none                &none           &none   &none  &none       &none   &mkp RCLK   &mkp LCLK                         &mkp MCLK           &none            &none       &none   &none
            >;
        };


        layer_MouseFine {
            bindings = <
 &trans  &trans  &trans  &trans  &trans                                                                  &trans  &trans  &trans  &trans  &trans
 &trans  &trans  &trans  &trans  &trans  &trans                                                  &trans  &trans  &trans  &trans  &trans  &trans
 &trans  &trans  &trans  &trans  &trans  &trans                                                  &trans  &trans  &trans  &trans  &trans  &trans
 &trans  &trans  &trans  &trans  &trans  &trans                                                  &trans  &trans  &trans  &trans  &trans  &trans
 &trans  &trans  &trans  &trans  &trans  &trans  &trans  &trans  &trans  &trans  &trans  &trans  &trans  &trans  &trans  &trans  &trans  &trans
 &trans  &trans  &trans  &trans  &trans          &trans  &trans  &trans  &trans  &trans  &trans          &trans  &trans  &trans  &trans  &trans
            >;
        };

        layer_MouseSlow {
            bindings = <
 &trans  &trans  &trans  &trans  &trans                                                                  &trans  &trans  &trans  &trans  &trans
 &trans  &trans  &trans  &trans  &trans  &trans                                                  &trans  &trans  &trans  &trans  &trans  &trans
 &trans  &trans  &trans  &trans  &trans  &trans                                                  &trans  &trans  &trans  &trans  &trans  &trans
 &trans  &trans  &trans  &trans  &trans  &trans                                                  &trans  &trans  &trans  &trans  &trans  &trans
 &trans  &trans  &trans  &trans  &trans  &trans  &trans  &trans  &trans  &trans  &trans  &trans  &trans  &trans  &trans  &trans  &trans  &trans
 &trans  &trans  &trans  &trans  &trans          &trans  &trans  &trans  &trans  &trans  &trans          &trans  &trans  &trans  &trans  &trans
            >;
        };

        layer_MouseFast {
            bindings = <
 &trans  &trans  &trans  &trans  &trans                                                                  &trans  &trans  &trans  &trans  &trans
 &trans  &trans  &trans  &trans  &trans  &trans                                                  &trans  &trans  &trans  &trans  &trans  &trans
 &trans  &trans  &trans  &trans  &trans  &trans                                                  &trans  &trans  &trans  &trans  &trans  &trans
 &trans  &trans  &trans  &trans  &trans  &trans                                                  &trans  &trans  &trans  &trans  &trans  &trans
 &trans  &trans  &trans  &trans  &trans  &trans  &trans  &trans  &trans  &trans  &trans  &trans  &trans  &trans  &trans  &trans  &trans  &trans
 &trans  &trans  &trans  &trans  &trans          &trans  &trans  &trans  &trans  &trans  &trans          &trans  &trans  &trans  &trans  &trans
            >;
        };

        layer_MouseWarp {
            bindings = <
 &trans  &trans  &trans  &trans  &trans                                                                  &trans  &trans  &trans  &trans  &trans
 &trans  &trans  &trans  &trans  &trans  &trans                                                  &trans  &trans  &trans  &trans  &trans  &trans
 &trans  &trans  &trans  &trans  &trans  &trans                                                  &trans  &trans  &trans  &trans  &trans  &trans
 &trans  &trans  &trans  &trans  &trans  &trans                                                  &trans  &trans  &trans  &trans  &trans  &trans
 &trans  &trans  &trans  &trans  &trans  &trans  &trans  &trans  &trans  &trans  &trans  &trans  &trans  &trans  &trans  &trans  &trans  &trans
 &trans  &trans  &trans  &trans  &trans          &trans  &trans  &trans  &trans  &trans  &trans          &trans  &trans  &trans  &trans  &trans
            >;
        };

    };
};

